## boards/shields/ztsvcosmos/Kconfig.defconfig
```kconfig
if SHIELD_ZTSVCOSMOS_LEFT

  config ZMK_KEYBOARD_NAME
      default "ztsv-cosmos-kb"

  config ZMK_SPLIT_ROLE_CENTRAL
      default y

endif

if SHIELD_ZTSVCOSMOS_LEFT || SHIELD_ZTSVCOSMOS_RIGHT

  config ZMK_SPLIT
      default y

endif
```

## boards/shields/ztsvcosmos/Kconfig.shield
```kconfig
config SHIELD_ZTSVCOSMOS_LEFT
    def_bool $(shields_list_contains,ztsvcosmos_left)

config SHIELD_ZTSVCOSMOS_RIGHT
    def_bool $(shields_list_contains,ztsvcosmos_right)
```
